VERSION ""

NS_ :

BS_:
BU_: ZeroGen2
BO_ 448 DASH_STATUS: 0 ZeroGen2

BO_ 385 CONTROLLER_SPEED_TORQUE: 0 ZeroGen2

BO_ 392 BMS_PACK_STATUS: 0 ZeroGen2

BO_ 393 BMS1_PACK_STATUS: 0 ZeroGen2

BO_ 960 DASH_ODO_TO_DASH: 0 ZeroGen2

BO_ 704 ODO_FROM_DASH: 0 ZeroGen2

BO_ 517 CONTROLLER_DRIVE_CONTROL: 0 ZeroGen2

BO_ 576 BMS_SOC_STATUS: 7 ZeroGen2
   SG_ battery_SOC : 55|8@0+ (1,0) [0|1] "" ZeroGen2

BO_ 648 CONTROLLER_RPM_THROTTLE_MOT_TEMP: 0 ZeroGen2
   SG_ throttleVoltage : 39|16@0+ (1,0) [0|1] "" ZeroGen2

BO_ 649 CONTROLLER_RPM_THROTTLE_MOT_TEMP435: 0 ZeroGen2

BO_ 776 BMS_PACK_STATS: 0 ZeroGen2

BO_ 777 BMS1_PACK_STATS: 0 ZeroGen2

BO_ 778 BMS1_PACK_STATS556: 0 ZeroGen2

BO_ 832 BIKE_ERROR_STATUS: 0 ZeroGen2
   SG_ ERROR_CODE : 55|8@0+ (1,0) [0|1] "" ZeroGen2

BO_ 897 CONTROLLER_TEMP_DIGITAL_IN_18: 0 ZeroGen2

BO_ 904 BMS_CELL_VOLTAGE: 0 ZeroGen2
   SG_ batteryVoltage : 32|24@1+ (0.246,0) [0|1] "" ZeroGen2

BO_ 905 BMS1_CELL_VOLTAGE: 0 ZeroGen2

BO_ 1032 BMS_PACK_ACTIVE_DATA: 0 ZeroGen2
   SG_ batteryAmps : 39|16@0+ (1,0) [0|1] "" Vector__XXX
   SG_ temperatureMax : 15|8@0+ (1,0) [0|1] "" ZeroGen2
   SG_ temperatureMin : 23|8@0+ (1,0) [0|1] "" Vector__XXX
   SG_ charger_voltage : 31|8@0+ (1,0) [0|1] "" Vector__XXX

BO_ 1033 BMS1_PACK_ACTIVE_DATA: 0 ZeroGen2

BO_ 1088 DASH_STATUS2: 0 ZeroGen2

BO_ 1160 BMS_PACK_TEMP_DATA: 0 ZeroGen2

BO_ 1286 BMS_CONTROL: 0 ZeroGen2

BO_ 1288 BMS_PACK_TIME: 0 ZeroGen2
   SG_ BMS_PACK_TIMESig452 : 39|16@0+ (1,0) [0|1] "" ZeroGen2

BO_ 1289 BMS1_PACK_TIME: 0 ZeroGen2

BO_ 1344 DASH_STATUS3: 0 ZeroGen2

BA_DEF_ BO_ "GenMsgBackgroundColor" STRING ;
BA_DEF_ BO_ "GenMsgForegroundColor" STRING ;
BA_DEF_DEF_ "GenMsgBackgroundColor" "#ffffff";
BA_DEF_DEF_ "GenMsgForegroundColor" "#000000";
